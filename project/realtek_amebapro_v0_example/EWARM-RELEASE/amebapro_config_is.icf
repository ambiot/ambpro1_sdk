// Select External RAM type - 1: LPDDR SDRAM 2: PSRAM
define exported symbol useERAM = 1;
// Reserve VOE buffer - 0: release video ram 1: reserve video ram
define exported symbol reserveVOE = 0;
// Select FW link address - 1: FW1(OTA1) 2: FW2(OTA2) 3:FWx(REMAP)
define exported symbol linkFW = 3;